## CMakeLists.txt
```
cmake_minimum_required(VERSION 3.20.0)

find_package(Zephyr REQUIRED HINTS $ENV{ZEPHYR_BASE})
project(Ajoittaja)

target_sources(app PRIVATE
    src/main.c
    src/schedules.c
)
```

## prj.conf
```kconfig
# Logging
CONFIG_LOG=y
```

## src/main.c
```c
/**
 * @file main.c
 * @brief Ajoittaja main
 * @author Kasperi Kiviluoma
 * @license MIT
 */

#include "schedules.h"
#include "system-time.h"
#include <zephyr/kernel.h>
#include <zephyr/logging/log.h>

#define THREAD_STACKSIZE 1024
#define THREAD_PRIORITY  7

// TODO: Allow to change log level
LOG_MODULE_REGISTER(Ajoittaja, LOG_LEVEL_DBG);

/**
 * TODO:
 * Remove, used for testing
 * The now variable is global; if possible, encapsulate it or limit its scope
 * The schedules array uses pointers to stack-allocated arrays; this is fine if
 * the arrays are never modified or freed, but consider using static or const
 * for safety Consider adding error handling or validation for schedule data Add
 * function documentation for schedule_handler (not shown here) If possible,
 * avoid magic numbers (like 3600, 7200, 10) by defining them as named constants
 */
Time now = {friday, 21, 59, 55};
Schedule mon[] = {{7, 0, 0, 3600}, {20, 0, 0, 7200}};
Schedule tue[] = {{7, 0, 0, 3600}, {20, 0, 0, 7200}};
Schedule wed[] = {{7, 0, 0, 3600}, {20, 0, 0, 7200}};
Schedule thu[] = {{7, 0, 0, 3600}, {20, 0, 0, 7200}};
Schedule fri[] = {{7, 0, 0, 3600}, {22, 0, 0, 10}};
Schedule sat[] = {{20, 0, 0, 7200}};
Schedule sun[] = {{20, 0, 0, 7200}};
Schedule *schedules[] = {mon, tue, wed, thu, fri, sat, sun};

// Schedules and current time handling
K_THREAD_DEFINE(schedule_handler_id, THREAD_STACKSIZE, schedule_handler, NULL,
                NULL, NULL, THREAD_PRIORITY, 0, 0);
```

## src/bluetooth.c
```c
/**
 * @file bluetooth.c
 * @brief Bluetooth handler functions
 * @author Kasperi Kiviluoma
 * @license MIT
 *
 * Handles communication between Ajoittaja and Ajoittaja Android
 * application with bluetooth.
 */

#include "bluetooth.h"
#include "cts_service.h"
#include "dk_buttons_and_leds.h"
#include "my_lbs.h"
#include "time-now.h"
#include <bluetooth/gatt_dm.h>
#include <bluetooth/services/lbs.h>
#include <zephyr/bluetooth/conn.h>
#include <zephyr/bluetooth/gap.h>
#include <zephyr/bluetooth/gatt.h>
#include <zephyr/kernel.h>

#include <zephyr/logging/log.h>

#include <dk_buttons_and_leds.h>

LOG_MODULE_DECLARE(Ajoittaja, LOG_LEVEL_DBG);

/**
 * @brief Callback for connection
 *
 * Set optimal settings for phy, data length and mtu.
 *
 * @param conn Connection
 * @param err Error code
 */
// TODO: OK
void on_connected(struct bt_conn *conn, uint8_t err);
/**
 * @brief Callback for disconnection
 *
 * @param conn Connection
 * @param reason Reason for disconnection
 */
// TODO: OK
void on_disconnected(struct bt_conn *conn, uint8_t reason);
/**
 * @brief Callback for connection parameter update
 *
 * Requested by the central device
 *
 * @param conn Connection
 * @param interval Connection interval
 * @param latency Connection latency
 */
// TODO: OK
void on_le_param_updated(struct bt_conn *conn, uint16_t interval,
                         uint16_t latency, uint16_t timeout);
/**
 * @brief Callback for PHY update (connection speed)
 *
 * @param conn Connection
 * @param param PHY parameters
 */
// TODO: OK
void on_le_phy_updated(struct bt_conn *conn, struct bt_conn_le_phy_info *param);
/**
 * @brief Callback for data length update
 *
 * @param conn Connection
 * @param info Data length parameters
 */
// TODO: OK
void on_le_data_len_updated(struct bt_conn *conn,
                            struct bt_conn_le_data_len_info *info);

/// Bt connection handle
// TODO: OK
struct bt_conn *bt_handle;

static void notify_current_time_cb(struct bt_cts_client *cts_c,
                                   struct bt_cts_current_time *current_time) {
    current_time_print(current_time);
}

static void enable_notifications(void) {
    int err;

    if (has_cts && (bt_conn_get_security(cts_c.conn) >= BT_SECURITY_L2)) {
        err = bt_cts_subscribe_current_time(&cts_c, notify_current_time_cb);
        if (err) {
            printk("Cannot subscribe to current time value notification (err "
                   "%d)\n",
                   err);
        }
    }
}

static void security_changed(struct bt_conn *conn, bt_security_t level,
                             enum bt_security_err err) {
    char addr[BT_ADDR_LE_STR_LEN];

    bt_addr_le_to_str(bt_conn_get_dst(conn), addr, sizeof(addr));

    if (!err) {
        printk("Security changed: %s level %u\n", addr, level);

        enable_notifications();
    } else {
        printk("Security failed: %s level %u err %d\n", addr, level, err);
    }
}

/// Connection callbacks
// TODO: OK
struct bt_conn_cb connection_callbacks = {
    .connected = on_connected,
    .disconnected = on_disconnected,
    .le_param_updated = on_le_param_updated,
    .le_phy_updated = on_le_phy_updated,
    .le_data_len_updated = on_le_data_len_updated,
    .security_changed = security_changed,
};

/// MTU exchange parameters
// TODO: OK
struct bt_gatt_exchange_params exchange_params;

// TODO: OK
void on_connected(struct bt_conn *conn, uint8_t err) {
    if (err) {
        LOG_ERR("Connection error %d.", err);
        return;
    }

    LOG_INF("Connected");
    bt_handle = bt_conn_ref(conn);

    // Log connection parameters
    struct bt_conn_info info;
    err = bt_conn_get_info(conn, &info);
    if (err) {
        LOG_ERR("bt_conn_get_info() returned %d.", err);
        return;
    }
    double connection_interval = info.le.interval * 1.25;   // in ms
    uint16_t supervision_timeout = info.le.timeout * 10;    // in ms
    LOG_INF("Initial connection parameters: interval %.2f ms, latency %d "
            "intervals, "
            "timeout %d ms.",
            connection_interval, info.le.latency, supervision_timeout);

    update_phy(bt_handle);
    update_data_length(bt_handle);
    update_mtu(bt_handle);

    has_cts = false;
    err = bt_gatt_dm_start(conn, BT_UUID_CTS, &discover_cb, NULL);
    if (err) {
        printk("Failed to start discovery (err %d)\n", err);
    }
}

// TODO: OK
void on_disconnected(struct bt_conn *conn, uint8_t reason) {
    LOG_INF("Disconnected. Reason %d.", reason);
    bt_conn_unref(bt_handle);
}

// TODO: OK
void on_le_param_updated(struct bt_conn *conn, uint16_t interval,
                         uint16_t latency, uint16_t timeout) {

    double connection_interval = interval * 1.25;   // in ms
    uint16_t supervision_timeout = timeout * 10;    // in ms
    LOG_INF("Connection parameters updated: interval %.2f ms, latency %d "
            "intervals, timeout %d ms",
            connection_interval, latency, supervision_timeout);
    update_phy(bt_handle);   // Force 2M PHY
}

// TODO: OK
void on_le_phy_updated(struct bt_conn *conn,
                       struct bt_conn_le_phy_info *param) {

    if (param->tx_phy == BT_CONN_LE_TX_POWER_PHY_1M) {
        LOG_INF("PHY updated. New PHY: 1M");
    } else if (param->tx_phy == BT_CONN_LE_TX_POWER_PHY_2M) {
        LOG_INF("PHY updated. New PHY: 2M");
    } else if (param->tx_phy == BT_CONN_LE_TX_POWER_PHY_CODED_S8) {
        LOG_INF("PHY updated. New PHY: Long Range");
    }
}

// TODO: OK
void on_le_data_len_updated(struct bt_conn *conn,
                            struct bt_conn_le_data_len_info *info) {
    uint16_t tx_len = info->tx_max_len;
    uint16_t tx_time = info->tx_max_time;
    uint16_t rx_len = info->rx_max_len;
    uint16_t rx_time = info->rx_max_time;
    LOG_INF("Data length updated. Length %d/%d bytes, time %d/%d us.", tx_len,
            rx_len, tx_time, rx_time);
}

/**
 * @brief Update PHY
 *
 * @param conn Connection
 */
// TODO: OK
void update_phy(struct bt_conn *conn) {
    int err;
    const struct bt_conn_le_phy_param preferred_phy = {
        .options = BT_CONN_LE_PHY_OPT_NONE,
        .pref_rx_phy = BT_GAP_LE_PHY_2M,
        .pref_tx_phy = BT_GAP_LE_PHY_2M,
    };
    err = bt_conn_le_phy_update(conn, &preferred_phy);
    if (err) {
        LOG_ERR("bt_conn_le_phy_update() returned %d.", err);
    }
}

/**
 * @brief Update data length
 *
 * @param conn Connection
 */
// TODO: OK
void update_data_length(struct bt_conn *conn) {
    int err;
    struct bt_conn_le_data_len_param my_data_len = {
        .tx_max_len = BT_GAP_DATA_LEN_MAX,
        .tx_max_time = BT_GAP_DATA_TIME_MAX,
    };
    err = bt_conn_le_data_len_update(bt_handle, &my_data_len);
    if (err) {
        LOG_ERR("data_len_update failed (err %d).", err);
    }
}

/**
 * @brief MTU exchange function
 *
 * @param conn Connection
 * @param att_err ATT error
 * @param params Exchange parameters
 */
// TODO: OK
void exchange_func(struct bt_conn *conn, uint8_t att_err,
                   struct bt_gatt_exchange_params *params) {
    LOG_INF("MTU exchange %s", att_err == 0 ? "successful." : "failed.");
    if (!att_err) {
        uint16_t payload_mtu =
            bt_gatt_get_mtu(conn) - 3;   // 3 bytes used for Attribute headers.
        LOG_INF("New MTU: %d bytes", payload_mtu);
    }
}

/**
 * @brief Update MTU
 *
 * @param conn Connection
 */
// TODO: OK
void update_mtu(struct bt_conn *conn) {
    int err;
    exchange_params.func = exchange_func;

    err = bt_gatt_exchange_mtu(conn, &exchange_params);
    if (err) {
        LOG_ERR("bt_gatt_exchange_mtu failed (err %d).", err);
    }
}

// TODO: OK
void ble_handler() {
    bool stop = false;

    if (bluetooth_init() != 0) {
        stop = true;
    } else {
        LOG_INF("Advertising successfully started");
    }

    while (!stop) {
        // TODO: Change to a more power efficient way to sleep
        int err;
        err = bt_cts_read_current_time(&cts_c, read_current_time_cb);
        if (err) {
            LOG_WRN("Failed reading current time (err: %d)\n", err);
        }
        k_sleep(K_SECONDS(2));
    }
}

static void app_led_cb(bool led_state) { dk_set_led(USER_LED, led_state); }
static bool app_button_state;
static bool app_button_cb(void) { return app_button_state; }
static struct my_lbs_cb app_callbacks = {
    .led_cb = app_led_cb,
    .button_cb = app_button_cb,
};

static void button_changed(uint32_t button_state, uint32_t has_changed) {
    if (has_changed & USER_BUTTON) {
        uint32_t user_button_state = button_state & USER_BUTTON;
        /* STEP 6 - Send indication on a button press */
        my_lbs_send_button_state_indicate(user_button_state);
        app_button_state = user_button_state ? true : false;
        my_lbs_send_button_state_indicate(user_button_state);
    }
}

static int init_button(void) {
    int err;

    err = dk_buttons_init(button_changed);
    if (err) {
        printk("Cannot init buttons (err: %d)\n", err);
    }

    return err;
}

static void auth_cancel(struct bt_conn *conn) {
    char addr[BT_ADDR_LE_STR_LEN];

    bt_addr_le_to_str(bt_conn_get_dst(conn), addr, sizeof(addr));

    printk("Pairing cancelled: %s\n", addr);

    bt_conn_disconnect(conn, BT_HCI_ERR_REMOTE_USER_TERM_CONN);
}

static struct bt_conn_auth_cb conn_auth_callbacks = {
    .cancel = auth_cancel,
};

static void pairing_complete(struct bt_conn *conn, bool bonded) {
    char addr[BT_ADDR_LE_STR_LEN];

    bt_addr_le_to_str(bt_conn_get_dst(conn), addr, sizeof(addr));

    printk("Pairing completed: %s, bonded: %d\n", addr, bonded);
}

static void pairing_failed(struct bt_conn *conn, enum bt_security_err reason) {
    char addr[BT_ADDR_LE_STR_LEN];

    bt_addr_le_to_str(bt_conn_get_dst(conn), addr, sizeof(addr));

    printk("Pairing failed conn: %s, reason %d\n", addr, reason);

    bt_conn_disconnect(conn, BT_HCI_ERR_REMOTE_USER_TERM_CONN);
}

static struct bt_conn_auth_info_cb conn_auth_info_callbacks = {
    .pairing_complete = pairing_complete, .pairing_failed = pairing_failed};

/**
 * @brief Start BLE advertising
 *
 * Initialize bluetooth and start advertising.
 *
 * @return Zero on success or (negative) error code otherwise
 */
// TODO: OK
int bluetooth_init() {
    int err;

    // Connection callbacks
    bt_conn_cb_register(&connection_callbacks);

    // Authorization callbacks
    err = bt_conn_auth_cb_register(&conn_auth_callbacks);
    if (err) {
        printk("Failed to register authorization callbacks\n");
        return 0;
    }
    err = bt_conn_auth_info_cb_register(&conn_auth_info_callbacks);
    if (err) {
        printk("Failed to register authorization info callbacks\n");
        return 0;
    }

    // Current Time Service client
    err = bt_cts_client_init(&cts_c);
    if (err) {
        LOG_ERR("CTS client init failed (err %d)\n", err);
        return 0;
    }

    // Enable
    err = bt_enable(NULL);
    if (err) {
        LOG_ERR("Bluetooth init failed (err %d)\n", err);
        return -1;
    }
    LOG_INF("Bluetooth initialized\n");

    // FIXME: Check
    init_button();
    err = my_lbs_init(&app_callbacks);
    if (err) {
        printk("Failed to init LBS (err:%d)\n", err);
        return -1;
    }

    // Start advertising
    err = bt_le_adv_start(adv_param, ad, ARRAY_SIZE(ad), sd, ARRAY_SIZE(sd));
    if (err) {
        LOG_ERR("Advertising failed to start (err %d)\n", err);
        return -1;
    }

    return err;
}
```

## src/bluetooth.h
```c
/**
 * @file bluetooth.h
 * @brief Bluetooth handler declarations
 * @author Kasperi Kiviluoma
 * @license MIT
 *
 * Handles communication between Ajoittaja and Ajoittaja Android
 * application via bluetooth.
 */

#include <zephyr/bluetooth/bluetooth.h>
#include <zephyr/bluetooth/uuid.h>

#define DEVICE_NAME     CONFIG_BT_DEVICE_NAME
#define DEVICE_NAME_LEN (sizeof(DEVICE_NAME) - 1)
// FIXME: Change to actual company code, needs to be registered
#define COMPANY_ID_CODE 0x0059

#define RUN_STATUS_LED DK_LED1
#define CON_STATUS_LED DK_LED2
#define USER_LED       DK_LED3
#define USER_BUTTON    DK_BTN1_MSK

/// Manufacturer data structure
typedef struct adv_mfg_data {
    uint16_t company_code;   // Company Identifier Code
} adv_mfg_data_type;

/// Manufacturer data
static adv_mfg_data_type adv_mfg_data = {COMPANY_ID_CODE};

/// Holds advertising data
// TODO: Consider BT_LE_AD_LIMITED
static const struct bt_data ad[] = {
    BT_DATA_BYTES(BT_DATA_FLAGS, (BT_LE_AD_GENERAL | BT_LE_AD_NO_BREDR)),
    BT_DATA_BYTES(BT_DATA_SOLICIT16, BT_UUID_16_ENCODE(BT_UUID_CTS_VAL)),
    BT_DATA(BT_DATA_NAME_COMPLETE, DEVICE_NAME, DEVICE_NAME_LEN),
    BT_DATA(BT_DATA_MANUFACTURER_DATA, (unsigned char *) &adv_mfg_data,
            sizeof(adv_mfg_data))};

/// Holds scan response data
// TODO: Change UUID to match a correct service
static const struct bt_data sd[] = {BT_DATA_BYTES(
    BT_DATA_UUID128_ALL,
    BT_UUID_128_ENCODE(0x00001523, 0x1212, 0xefde, 0x1523, 0x785feabcd123))};

/// Advertising parameters
/// TODO: Consider disabling BT_LE_ADV_OPT_USE_IDENTITY
/// TODO: Consider changing advertising interval in order to save power
static struct bt_le_adv_param *adv_param =
    BT_LE_ADV_PARAM((BT_LE_ADV_OPT_CONNECTABLE | BT_LE_ADV_OPT_USE_IDENTITY),
                    800,     // Min Advertising Interval 500ms (800*0.625ms)
                    801,     // Max Advertising Interval 500.625ms (801*0.625ms)
                    NULL);   // Set to NULL for undirected advertising

/// BLE thread handler
void ble_handler();
```

## src/cts_service.c
```c
#include "cts_service.h"

struct bt_cts_client cts_c;   // Definition, memory allocated here

static const char *day_of_week[] = {"Unknown",   "Monday",   "Tuesday",
                                    "Wednesday", "Thursday", "Friday",
                                    "Saturday",  "Sunday"};

static const char *month_of_year[] = {
    "Unknown", "January", "February",  "March",   "April",    "May",     "June",
    "July",    "August",  "September", "October", "November", "December"};

void current_time_print(struct bt_cts_current_time *current_time) {
    printk("\nCurrent Time:\n");
    printk("\nDate:\n");

    printk("\tDay of week   %s\n",
           day_of_week[current_time->exact_time_256.day_of_week]);

    if (current_time->exact_time_256.day == 0) {
        printk("\tDay of month  Unknown\n");
    } else {
        printk("\tDay of month  %u\n", current_time->exact_time_256.day);
    }

    printk("\tMonth of year %s\n",
           month_of_year[current_time->exact_time_256.month]);
    if (current_time->exact_time_256.year == 0) {
        printk("\tYear          Unknown\n");
    } else {
        printk("\tYear          %u\n", current_time->exact_time_256.year);
    }
    printk("\nTime:\n");
    printk("\tHours     %u\n", current_time->exact_time_256.hours);
    printk("\tMinutes   %u\n", current_time->exact_time_256.minutes);
    printk("\tSeconds   %u\n", current_time->exact_time_256.seconds);
    printk("\tFractions %u/256 of a second\n",
           current_time->exact_time_256.fractions256);

    printk("\nAdjust reason:\n");
    printk("\tDaylight savings %x\n",
           current_time->adjust_reason.change_of_daylight_savings_time);
    printk("\tTime zone        %x\n",
           current_time->adjust_reason.change_of_time_zone);
    printk("\tExternal update  %x\n",
           current_time->adjust_reason.external_reference_time_update);
    printk("\tManual update    %x\n",
           current_time->adjust_reason.manual_time_update);
}

void read_current_time_cb(struct bt_cts_client *cts_c,
                          struct bt_cts_current_time *current_time, int err) {
    char addr[BT_ADDR_LE_STR_LEN];

    bt_addr_le_to_str(bt_conn_get_dst(cts_c->conn), addr, sizeof(addr));

    if (err) {
        printk("Cannot read Current Time: %s, error: %d\n", addr, err);
        return;
    }

    current_time_print(current_time);
}

static void notify_current_time_cb(struct bt_cts_client *cts_c,
                                   struct bt_cts_current_time *current_time) {
    current_time_print(current_time);
}

static void enable_notifications(void) {
    int err;

    if (has_cts && (bt_conn_get_security(cts_c.conn) >= BT_SECURITY_L2)) {
        err = bt_cts_subscribe_current_time(&cts_c, notify_current_time_cb);
        if (err) {
            printk("Cannot subscribe to current time value notification (err "
                   "%d)\n",
                   err);
        }
    }
}

void discover_service_not_found_cb(struct bt_conn *conn, void *ctx) {
    printk("The service could not be found during the discovery\n");
}

void discover_error_found_cb(struct bt_conn *conn, int err, void *ctx) {
    printk("The discovery procedure failed, err %d\n", err);
}

void discover_completed_cb(struct bt_gatt_dm *dm, void *ctx) {
    int err;

    printk("The discovery procedure succeeded\n");

    bt_gatt_dm_data_print(dm);

    err = bt_cts_handles_assign(dm, &cts_c);
    if (err) {
        printk("Could not assign CTS client handles, error: %d\n", err);
    } else {
        has_cts = true;

        if (bt_conn_get_security(cts_c.conn) < BT_SECURITY_L2) {
            err = bt_conn_set_security(cts_c.conn, BT_SECURITY_L2);
            if (err) {
                printk("Failed to set security (err %d)\n", err);
            }
        } else {
            enable_notifications();
        }
    }

    err = bt_gatt_dm_data_release(dm);
    if (err) {
        printk("Could not release the discovery data, error "
               "code: %d\n",
               err);
    }
}
```

## src/cts_service.h
```c
/*
 * Copyright (c) 2018 Nordic Semiconductor ASA
 *
 * SPDX-License-Identifier: LicenseRef-Nordic-5-Clause
 */

#ifndef CTS_SERVICE_H_
#define CTS_SERVICE_H_

#include <bluetooth/services/cts_client.h>

extern struct bt_cts_client cts_c;

static bool has_cts;

void discover_completed_cb(struct bt_gatt_dm *dm, void *ctx);

void discover_service_not_found_cb(struct bt_conn *conn, void *ctx);

void discover_error_found_cb(struct bt_conn *conn, int err, void *ctx);

void current_time_print(struct bt_cts_current_time *current_time);

void read_current_time_cb(struct bt_cts_client *cts_c,
                          struct bt_cts_current_time *current_time, int err);

static const struct bt_gatt_dm_cb discover_cb = {
    .completed = discover_completed_cb,
    .service_not_found = discover_service_not_found_cb,
    .error_found = discover_error_found_cb,
};

#endif   // CTS_SERVICE_H_
```

## src/my_lbs.c
```c
/*
 * Copyright (c) 2018 Nordic Semiconductor ASA
 *
 * SPDX-License-Identifier: LicenseRef-Nordic-5-Clause
 */

/** @file
 *  @brief LED Button Service (LBS) sample
 */

#include <errno.h>
#include <stddef.h>
#include <string.h>
#include <zephyr/bluetooth/bluetooth.h>
#include <zephyr/bluetooth/conn.h>
#include <zephyr/bluetooth/gatt.h>
#include <zephyr/bluetooth/hci.h>
#include <zephyr/bluetooth/uuid.h>
#include <zephyr/kernel.h>
#include <zephyr/logging/log.h>
#include <zephyr/sys/byteorder.h>
#include <zephyr/sys/printk.h>
#include <zephyr/types.h>

#include "my_lbs.h"

LOG_MODULE_DECLARE(Lesson4_Exercise2);

static bool notify_mysensor_enabled;
static bool indicate_enabled;
static bool button_state;
static struct my_lbs_cb lbs_cb;

/* STEP 4 - Define an indication parameter */
static struct bt_gatt_indicate_params ind_params;

/* STEP 3 - Implement the configuration change callback function */
static void mylbsbc_ccc_cfg_changed(const struct bt_gatt_attr *attr,
                                    uint16_t value) {
    indicate_enabled = (value == BT_GATT_CCC_INDICATE);
}

/* STEP 13 - Define the configuration change callback function for the MYSENSOR
 * characteristic */
static void mylbsbc_ccc_mysensor_cfg_changed(const struct bt_gatt_attr *attr,
                                             uint16_t value) {
    notify_mysensor_enabled = (value == BT_GATT_CCC_NOTIFY);
}

// This function is called when a remote device has acknowledged the indication
// at its host layer
static void indicate_cb(struct bt_conn *conn,
                        struct bt_gatt_indicate_params *params, uint8_t err) {
    LOG_DBG("Indication %s\n", err != 0U ? "fail" : "success");
}
static ssize_t write_led(struct bt_conn *conn, const struct bt_gatt_attr *attr,
                         const void *buf, uint16_t len, uint16_t offset,
                         uint8_t flags) {
    LOG_DBG("Attribute write, handle: %u, conn: %p", attr->handle,
            (void *) conn);

    if (len != 1U) {
        LOG_DBG("Write led: Incorrect data length");
        return BT_GATT_ERR(BT_ATT_ERR_INVALID_ATTRIBUTE_LEN);
    }

    if (offset != 0) {
        LOG_DBG("Write led: Incorrect data offset");
        return BT_GATT_ERR(BT_ATT_ERR_INVALID_OFFSET);
    }

    if (lbs_cb.led_cb) {
        // Read the received value
        uint8_t val = *((uint8_t *) buf);

        if (val == 0x00 || val == 0x01) {
            // Call the application callback function to update the LED state
            lbs_cb.led_cb(val ? true : false);
        } else {
            LOG_DBG("Write led: Incorrect value");
            return BT_GATT_ERR(BT_ATT_ERR_VALUE_NOT_ALLOWED);
        }
    }

    return len;
}

static ssize_t read_button(struct bt_conn *conn,
                           const struct bt_gatt_attr *attr, void *buf,
                           uint16_t len, uint16_t offset) {
    // get a pointer to button_state which is passed in the
    // BT_GATT_CHARACTERISTIC() and stored in attr->user_data
    const char *value = attr->user_data;

    LOG_DBG("Attribute read, handle: %u, conn: %p", attr->handle,
            (void *) conn);

    if (lbs_cb.button_cb) {
        // Call the application callback function to update the get the current
        // value of the button
        button_state = lbs_cb.button_cb();
        return bt_gatt_attr_read(conn, attr, buf, len, offset, value,
                                 sizeof(*value));
    }

    return 0;
}

/* LED Button Service Declaration */
BT_GATT_SERVICE_DEFINE(
    my_lbs_svc, BT_GATT_PRIMARY_SERVICE(BT_UUID_LBS),
    /* STEP 1 - Modify the Button characteristic declaration to support
       indication */
    BT_GATT_CHARACTERISTIC(BT_UUID_LBS_BUTTON,
                           BT_GATT_CHRC_READ | BT_GATT_CHRC_INDICATE,
                           BT_GATT_PERM_READ, read_button, NULL, &button_state),
    /* STEP 2 - Create and add the Client Characteristic Configuration
       Descriptor */
    BT_GATT_CCC(mylbsbc_ccc_cfg_changed,
                BT_GATT_PERM_READ | BT_GATT_PERM_WRITE),

    BT_GATT_CHARACTERISTIC(BT_UUID_LBS_LED, BT_GATT_CHRC_WRITE,
                           BT_GATT_PERM_WRITE, NULL, write_led, NULL),
    /* STEP 12 - Create and add the MYSENSOR characteristic and its CCCD  */
    BT_GATT_CHARACTERISTIC(BT_UUID_LBS_MYSENSOR, BT_GATT_CHRC_NOTIFY,
                           BT_GATT_PERM_NONE, NULL, NULL, NULL),

    BT_GATT_CCC(mylbsbc_ccc_mysensor_cfg_changed,
                BT_GATT_PERM_READ | BT_GATT_PERM_WRITE),

);
/* A function to register application callbacks for the LED and Button
 * characteristics  */
int my_lbs_init(struct my_lbs_cb *callbacks) {
    if (callbacks) {
        lbs_cb.led_cb = callbacks->led_cb;
        lbs_cb.button_cb = callbacks->button_cb;
    }

    return 0;
}

/* STEP 5 - Define the function to send indications */
int my_lbs_send_button_state_indicate(bool button_state) {
    if (!indicate_enabled) {
        return -EACCES;
    }
    ind_params.attr = &my_lbs_svc.attrs[2];
    ind_params.func =
        indicate_cb;   // A remote device has ACKed at its host layer (ATT ACK)
    ind_params.destroy = NULL;
    ind_params.data = &button_state;
    ind_params.len = sizeof(button_state);
    return bt_gatt_indicate(NULL, &ind_params);
}

/* STEP 14 - Define the function to send notifications for the MYSENSOR
 * characteristic */
int my_lbs_send_sensor_notify(uint32_t sensor_value) {
    if (!notify_mysensor_enabled) {
        return -EACCES;
    }

    return bt_gatt_notify(NULL, &my_lbs_svc.attrs[7], &sensor_value,
                          sizeof(sensor_value));
}
```

## src/my_lbs.h
```c
/*
 * Copyright (c) 2018 Nordic Semiconductor ASA
 *
 * SPDX-License-Identifier: LicenseRef-Nordic-5-Clause
 */

#ifndef BT_LBS_H_
#define BT_LBS_H_

/**@file
 * @defgroup bt_lbs LED Button Service API
 * @{
 * @brief API for the LED Button Service (LBS).
 */

#ifdef __cplusplus
extern "C" {
#endif

#include <zephyr/types.h>

/** @brief LBS Service UUID. */
#define BT_UUID_LBS_VAL                                                        \
    BT_UUID_128_ENCODE(0x00001523, 0x1212, 0xefde, 0x1523, 0x785feabcd123)

/** @brief Button Characteristic UUID. */
#define BT_UUID_LBS_BUTTON_VAL                                                 \
    BT_UUID_128_ENCODE(0x00001524, 0x1212, 0xefde, 0x1523, 0x785feabcd123)

/** @brief LED Characteristic UUID. */
#define BT_UUID_LBS_LED_VAL                                                    \
    BT_UUID_128_ENCODE(0x00001525, 0x1212, 0xefde, 0x1523, 0x785feabcd123)

/* STEP 11.1 - Assign a UUID to the MYSENSOR characteristic */
/** @brief LED Characteristic UUID. */
#define BT_UUID_LBS_MYSENSOR_VAL                                               \
    BT_UUID_128_ENCODE(0x00001526, 0x1212, 0xefde, 0x1523, 0x785feabcd123)

#define BT_UUID_LBS        BT_UUID_DECLARE_128(BT_UUID_LBS_VAL)
#define BT_UUID_LBS_BUTTON BT_UUID_DECLARE_128(BT_UUID_LBS_BUTTON_VAL)
#define BT_UUID_LBS_LED    BT_UUID_DECLARE_128(BT_UUID_LBS_LED_VAL)
/* STEP 11.2 - Convert the array to a generic UUID */
#define BT_UUID_LBS_MYSENSOR BT_UUID_DECLARE_128(BT_UUID_LBS_MYSENSOR_VAL)

/** @brief Callback type for when an LED state change is received. */
typedef void (*led_cb_t)(const bool led_state);

/** @brief Callback type for when the button state is pulled. */
typedef bool (*button_cb_t)(void);

/** @brief Callback struct used by the LBS Service. */
struct my_lbs_cb {
    /** LED state change callback. */
    led_cb_t led_cb;
    /** Button read callback. */
    button_cb_t button_cb;
};

/** @brief Initialize the LBS Service.
 *
 * This function registers application callback functions with the My LBS
 * Service
 *
 * @param[in] callbacks Struct containing pointers to callback functions
 *			used by the service. This pointer can be NULL
 *			if no callback functions are defined.
 *
 *
 * @retval 0 If the operation was successful.
 *           Otherwise, a (negative) error code is returned.
 */
int my_lbs_init(struct my_lbs_cb *callbacks);

/** @brief Send the button state as indication.
 *
 * This function sends a binary state, typically the state of a
 * button, to all connected peers.
 *
 * @param[in] button_state The state of the button.
 *
 * @retval 0 If the operation was successful.
 *           Otherwise, a (negative) error code is returned.
 */
int my_lbs_send_button_state_indicate(bool button_state);

/** @brief Send the button state as notification.
 *
 * This function sends a binary state, typically the state of a
 * button, to all connected peers.
 *
 * @param[in] button_state The state of the button.
 *
 * @retval 0 If the operation was successful.
 *           Otherwise, a (negative) error code is returned.
 */
int my_lbs_send_button_state_notify(bool button_state);

/** @brief Send the sensor value as notification.
 *
 * This function sends an uint32_t  value, typically the value
 * of a simulated sensor to all connected peers.
 *
 * @param[in] sensor_value The value of the simulated sensor.
 *
 * @retval 0 If the operation was successful.
 *           Otherwise, a (negative) error code is returned.
 */
int my_lbs_send_sensor_notify(uint32_t sensor_value);

#ifdef __cplusplus
}
#endif

/**
 * @}
 */

#endif /* BT_LBS_H_ */
```

## src/schedules.c
```c
/**
 * @file schedules.c
 * @brief Implementation of the Ajoittaja schedules handler
 * @author Kasperi Kiviluoma
 * @license MIT
 *
 * Contains the implementation for handling the GPIO pin state based on the set
 * schedules. Keeps track of the current time.
 */

#include "schedules.h"

#include "system-time.h"
#include <zephyr/kernel.h>
#include <zephyr/logging/log.h>

#define GPIO_LOW  0
#define GPIO_HIGH 1

/**
 * TODO:
 * The schedules variable is used as an external array; ensure it is defined and
 * initialized in one source file (likely main.c). Consider using const for
 * schedule arrays if they are not modified at runtime. Magic numbers (like
 * 3600, 60, etc.) could be replaced with named constants for clarity. Add error
 * handling for timer initialization and GPIO operations. Consider documenting
 * the expected range and meaning of now.day (e.g., enum values for weekdays).
 * If possible, move GPIO-specific code to a separate module for better
 * separation of concerns.
 */

// TODO: Allow to change log level
LOG_MODULE_DECLARE(Ajoittaja, LOG_LEVEL_DBG);

struct gpio_dt_spec gpio_pin =
    GPIO_DT_SPEC_GET(DT_NODELABEL(led2), gpios);   // TODO: Make configurable
struct k_timer gpio_low_timer;

void schedule_handler() {
    bool stop = false;
    k_timer_init(&gpio_low_timer, gpio_set_low, NULL);

    if (gpio_init() != 0) {
        LOG_ERR("GPIO init failed");
        stop = true;
    }

    while (!stop) {
        k_sleep(K_SECONDS(1));
        system_time.second++;
        update_system_time();
        check_schedules();
    }
}

void update_system_time() {
    if (system_time.second >= 60) {
        system_time.second = 0;
        system_time.minute++;
        if (system_time.minute >= 60) {
            system_time.minute = 0;
            system_time.hour++;
            if (system_time.hour >= 24) {
                system_time.hour = 0;
                system_time.day++;
                if (system_time.day >= sunday) {
                    system_time.day = monday;
                }
            }
        }
    }
    LOG_INF("Time: %02d:%02d:%02d", system_time.hour, system_time.minute,
            system_time.second);
}

void check_schedules() {
    // Check if any of the schedules should be triggered
    // schedules is organized so that schedules[0] is monday, etc..
    if (k_timer_remaining_get(&gpio_low_timer) == 0) {
        int i = system_time.day;
        for (int j = 0; j < SCHEDULE_SIZE; j++) {
            // Convert schedule start time and current time to seconds
            int start_seconds = schedules[i][j].start_hour * 3600 +
                                schedules[i][j].start_minute * 60 +
                                schedules[i][j].start_second;
            int now_seconds = system_time.hour * 3600 +
                              system_time.minute * 60 + system_time.second;

            // Check if the current time matches or is within the
            // scheduled duration
            // This ensures that even if the device is started in the middle of
            // the schedule, schedule is still activated
            if (now_seconds >= start_seconds &&
                now_seconds < start_seconds + schedules[i][j].duration) {

                LOG_INF("Turn GPIO to HIGH state");
                gpio_pin_set_dt(&gpio_pin, GPIO_HIGH);

                // Calculate the remaining duration the GPIO driver
                // should be in HIGH state
                int remaining_duration =
                    start_seconds + schedules[i][j].duration - now_seconds;

                if (remaining_duration > 0) {
                    k_timer_start(&gpio_low_timer,
                                  K_SECONDS(remaining_duration), K_NO_WAIT);
                }
                break;
            }
        }
    }
}

int gpio_init(void) {
    // Check if the device is ready
    if (!device_is_ready(gpio_pin.port)) {
        return -1;
    }
    gpio_pin_configure_dt(&gpio_pin, GPIO_ACTIVE_HIGH | GPIO_OUTPUT_INACTIVE);
    return 0;
}

void gpio_set_low() {
    LOG_INF("Turn GPIO to LOW state");
    gpio_pin_set_dt(&gpio_pin, GPIO_LOW);
}
```

## src/schedules.h
```c
/**
 * @file schedules.h
 * @brief Handles Ajoittaja schedules
 * @author Kasperi Kiviluoma
 * @license MIT
 *
 * Turn the GPIO pin high/low based on the set schedules.
 */

#pragma once

#include <zephyr/drivers/gpio.h>

// Max schedules in a day
#define SCHEDULE_SIZE 3

/**
 * TODO:
 * Consider using const for schedule arrays if they are not modified at runtime
 * SCHEDULE_SIZE is defined but not used in this header; ensure it is used
 * consistently in implementation If possible, group related functions (e.g.,
 * GPIO functions) in a separate header for better modularity Add parameter
 * documentation for functions that take arguments Consider documenting expected
 * time units for duration (e.g., seconds)
 */

/**
 * @brief Contains the start time and duration
 *
 * One schedule array contains all the start times for the day.
 */
typedef struct {
    uint8_t start_hour;
    uint8_t start_minute;
    uint8_t start_second;
    uint32_t duration;
} Schedule;

extern Schedule mon[];
extern Schedule tue[];
extern Schedule wed[];
extern Schedule thu[];
extern Schedule fri[];
extern Schedule sat[];
extern Schedule sun[];

/**
 * @brief Array of pointers to the daily schedules
 */
extern Schedule *schedules[];

/**
 * @brief Keep track of the time and turn gpio on/off based on the schedules
 */
void schedule_handler();

/**
 * @brief Update the current time
 */
void update_system_time();

/**
 * @brief Toggle gpio based on the schedules
 *
 * If current time is within the schedule turn gpio HIGH and set timer to turn
 * it LOW.
 */
void check_schedules();

/**
 * @brief Initialize the GPIO pin
 *
 * @retval 0  Initialization successful
 * @retval -1 Initialization failed
 */
int gpio_init(void);

/**
 * @brief Timer callback to set gpio LOW
 */
void gpio_set_low();
```

## src/system-time.h
```c
/**
 * @file system-time.h
 * @brief Time definitions
 * @author Kasperi Kiviluoma
 * @license MIT
 */

#pragma once

/**
 * TODO:
 * Consider using enum Weekday as the type for Time.day instead of uint8_t for
 * stronger type safety. Add documentation for the valid range of each field in
 * Time. If now should not be modified outside a specific module, consider
 * encapsulating it or providing getter/setter functions.
 */

/**
 * @brief The weekday enum
 *
 * Used to set day of the schedule more easily.
 */
enum Weekday {
    monday,
    tuesday,
    wednesday,
    thursday,
    friday,
    saturday,
    sunday,
};

/**
 * @brief The time struct
 *
 * Used to set the time of the schedule more easily.
 */
typedef struct {
    uint8_t day;
    uint8_t hour;
    uint8_t minute;
    uint8_t second;
} Time;

/// The current time
extern Time system_time;
```

## src/time-now.h
```c
/**
 * @file time-now.h
 * @brief Time definitions
 * @author Kasperi Kiviluoma
 * @license MIT
 */

/**
 * @brief The weekday enum
 *
 * Used to set day of the schedule more easily.
 */
enum Weekday {
    monday,
    tuesday,
    wednesday,
    thursday,
    friday,
    saturday,
    sunday,
};

/**
 * @brief The time struct
 *
 * Used to set the time of the schedule more easily.
 */
typedef struct {
    uint8_t day;
    uint8_t hour;
    uint8_t minute;
    uint8_t second;
} Time;

/// The current time
extern Time now;
```

## src/timer.c
```c
/**
 * @file timer.c
 * @brief Implementation of the Ajoittaja schedule handlers.
 * @author Kasperi Kiviluoma
 * @license MIT
 *
 * Contains the implementation for handling the GPIO pin state based on the set
 * schedules. Keeps track of the current time.
 */

#include "timer.h"
#include <zephyr/logging/log.h>

/////////////
// Set up //
///////////

LOG_MODULE_DECLARE(Ajoittaja, LOG_LEVEL_DBG);

// Connect GPIO driver to this pin
struct gpio_dt_spec gpio_pin = GPIO_DT_SPEC_GET(DT_NODELABEL(led0), gpios);

// Turn GPIO state HIGH for the duration of the schedule
void gpio_high(uint32_t duration);

#define GPIO_LOW  1
#define GPIO_HIGH 0
bool gpio_state = GPIO_LOW;

const nrfx_rtc_t time_rtc = NRFX_RTC_INSTANCE(TIME_RTC_INSTANCE);
const nrfx_rtc_t schedule_rtc = NRFX_RTC_INSTANCE(SCHEDULE_RTC_INSTANCE);

///////////
// GPIO //
/////////

int gpio_init(void) {
    // Check if the device is ready
    if (!device_is_ready(gpio_pin.port)) {
        return -1;
    }

    // BUG: GPIO is HIGH if pin is set to logical 0
    gpio_pin_configure_dt(&gpio_pin, GPIO_OUTPUT_ACTIVE);

    return 0;
}

///////////////////////
// Real Time Clocks //
/////////////////////

nrfx_err_t rtc_init(int prescaler_val, const nrfx_rtc_t rtc,
                    nrfx_rtc_handler_t handler, bool tick_irq) {
    nrfx_err_t retval;

    // Set default conf, change prescaler and init
    nrfx_rtc_config_t conf = NRFX_RTC_DEFAULT_CONFIG;
    conf.prescaler = prescaler_val;
    retval = nrfx_rtc_init(&rtc, &conf, handler);

    // Enable tick event and start RTC
    if (retval == NRFX_SUCCESS) {
        nrfx_rtc_tick_enable(&rtc, tick_irq);
        nrfx_rtc_enable(&rtc);
    }

    return retval;
}

void manual_isr_setup() {
    IRQ_DIRECT_CONNECT(RTC0_IRQn, 0, nrfx_rtc_0_irq_handler, 0);
    irq_enable(RTC0_IRQn);

    IRQ_DIRECT_CONNECT(RTC2_IRQn, 0, nrfx_rtc_2_irq_handler, 0);
    irq_enable(RTC2_IRQn);
}

void time_handler(nrfx_rtc_int_type_t int_type) {
    // Keep track of the current time
    if (int_type == NRFX_RTC_INT_TICK) {
        // Counter is incremented every 125 ms
        if (nrfx_rtc_counter_get(&time_rtc) >= 8) {
            now.second++;
            if (now.second >= 60) {
                now.second = 0;
                now.minute++;
                if (now.minute >= 60) {
                    now.minute = 0;
                    now.hour++;
                    if (now.hour >= 24) {
                        now.hour = 0;
                        now.day++;
                        if (now.day >= sunday) {
                            now.day = monday;
                        }
                    }
                }
            }
            // Needs to be cleared to keep track of the seconds passed
            nrfx_rtc_counter_clear(&time_rtc);

            LOG_INF("Time: %02d:%02d:%02d", now.hour, now.minute, now.second);

            // Check if any of the schedules should be triggered
            // schedules is organized so that schedules[0] is monday, etc..
            if (gpio_state == GPIO_LOW) {
                int i = now.day;
                for (int j = 0; j < SCHEDULE_SIZE; j++) {
                    // Calculate the total seconds for the start and current
                    // time Without this the GPIO driver is not turned HIGH if
                    // Ajoittaja was turned HIGH after the start time
                    int start_seconds = schedules[i][j].start_hour * 3600 +
                                        schedules[i][j].start_minute * 60 +
                                        schedules[i][j].start_second;
                    int now_seconds =
                        now.hour * 3600 + now.minute * 60 + now.second;

                    // Check if the current time matches or is within the
                    // scheduled duration
                    if (now_seconds >= start_seconds &&
                        now_seconds <
                            start_seconds + schedules[i][j].duration) {

                        // Calculate the remaining duration the GPIO driver
                        // should be in HIGH state
                        int remaining_duration = start_seconds +
                                                 schedules[i][j].duration -
                                                 now_seconds;

                        gpio_high(remaining_duration);
                        break;
                    }
                }
            }
        }
    }
}

void schedule_handler(nrfx_rtc_int_type_t int_type) {
    LOG_INF("Schedule handler");
    if (int_type == NRFX_RTC_INT_COMPARE0) {
        LOG_INF("Turn GPIO to LOW state");
        gpio_state = GPIO_LOW;
        gpio_pin_set_dt(&gpio_pin, GPIO_LOW);
    }
}

void gpio_high(uint32_t duration) {
    // Clear counter to start counting from 0
    nrfx_rtc_counter_clear(&schedule_rtc);

    // Set compare value to trigger interrupt when it is time to turn GPIO state
    // LOW Convert from seconds to ticks
    if (nrfx_rtc_cc_set(&schedule_rtc, 0, duration * 8, true) != NRFX_SUCCESS) {
        LOG_ERR("Failed to set compare value for the schedule RTC");
    } else {
        LOG_INF("Turn GPIO to HIGH state");
        gpio_state = GPIO_HIGH;
        gpio_pin_set_dt(&gpio_pin, GPIO_HIGH);
    }
}
```

## src/timer.h
```c
/**
 * @file timer.h
 * @brief Handles Ajoittaja schedules.
 * @author Kasperi Kiviluoma
 * @license MIT
 *
 * Turn the GPIO pin high/low based on the set schedules.
 */

#pragma once

#include <nrfx_rtc.h>
#include <zephyr/drivers/gpio.h>

///////////
// GPIO //
/////////

/**
 * Initialize the GPIO pin.
 *
 * @retval 0  Initialization successful.
 * @retval -1 Initialization failed.
 */
int gpio_init(void);

///////////
// Time //
/////////

/**
 * @brief The weekday enum.
 *
 * Used to set day of the schedule more easily.
 */
enum Weekday {
    monday,
    tuesday,
    wednesday,
    thursday,
    friday,
    saturday,
    sunday,
};

/**
 * @brief The time struct.
 *
 * Used to set the time of the schedule more easily.
 */
typedef struct {
    uint8_t day;
    uint8_t hour;
    uint8_t minute;
    uint8_t second;
} Time;

/// The current time.
extern Time now;

////////////////
// Schedules //
//////////////

#define SCHEDULE_SIZE 3

/**
 * @brief Contains the start time and duration.
 *
 * One schedule array contains all the start times for the day.
 */
typedef struct {
    uint8_t start_hour;
    uint8_t start_minute;
    uint8_t start_second;
    uint32_t duration;
} Schedule;

/// Monday schedule.
extern Schedule mon[];
/// Tuesday schedule.
extern Schedule tue[];
/// Wednesday schedule.
extern Schedule wed[];
/// Thursday schedule.
extern Schedule thu[];
/// Friday schedule.
extern Schedule fri[];
/// Saturday schedule.
extern Schedule sat[];
/// Sunday schedule.
extern Schedule sun[];

/// Array of pointers to the daily schedules.
extern Schedule *schedules[];

///////////////////////
// Real Time Clocks //
/////////////////////

#define TIME_RTC_INSTANCE     0
#define SCHEDULE_RTC_INSTANCE 2
extern const nrfx_rtc_t time_rtc;
extern const nrfx_rtc_t schedule_rtc;

/**
 * @brief Initializes the RTC module.
 *
 * Uses the given prescaler value to configure the RTC's tick rate.
 *
 * @param prescaler_val Prescaler value to configure the RTC's TICK event rate.
 * @param rtc           A pointer to an instance of the RTC to be initialized.
 * @param handler       Event handler callback function for RTC-related events.
 * @param tick_irq      Enable/disable tick event interrupt.
 *
 * @retval NRFX_SUCCESS             Successfully initialized.
 * @retval NRFX_ERROR_INVALID_STATE The instance is already initialized.
 */
nrfx_err_t rtc_init(int prescaler_val, const nrfx_rtc_t rtc,
                    nrfx_rtc_handler_t handler, bool tick_irq);

/// Setup RTC interrupt handlers
void manual_isr_setup();

/**
 * @brief Handler for the time RTC interrupts.
 *
 * Keeps track of the current time. If the current time matches to the start
 * time of a schedule turn the GPIO state HIGH and set the compare value to
 * trigger an interrupt when it is time to turn LOW.
 *
 * @param irq_type Type of the interrupt.
 */
void time_handler(nrfx_rtc_int_type_t irq_type);

/**
 * If triggered by a compare event, turns the GPIO state LOW.
 *
 * @param irq_type Type of the interrupt.
 */
void schedule_handler(nrfx_rtc_int_type_t int_type);
```
